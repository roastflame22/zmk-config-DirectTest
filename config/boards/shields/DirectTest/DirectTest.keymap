#include <dt-bindings/zmk/keys.h>

/{
    keymap {
        compatible = "zmk,keymap";

        default_layer {
            bindings = <
                &kp KP_N1
                &kp KP_N2
            >;
        };
    };
};